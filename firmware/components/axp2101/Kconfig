## firmware/components/axp2101/Kconfig
```kconfig
menu "AXP2101 PMIC"
    config AXP2101_DISABLE_RAILS_ON_SLEEP
        bool "Switch off the PMIC output rails before deep sleep"
        default n
        help
            Saves power but, on some board revisions, switching off ALDO3 clamps
            the I2C bus so the RTC and PMIC become unreachable after wake-up.
            Enable only after checking on your board that wake-ups still work.
endmenu
```

## firmware/main/Kconfig.projbuild
```kconfig
menu "Atchou frame"
    config ATCHOU_SERVER_URL
        string "Server URL"
        default "https://atchou.lasarriette.be"

    config ATCHOU_DEVICE_TOKEN
        string "Device token (bearer)"
        default ""
        help
            Set it in the gitignored sdkconfig.secrets file (see firmware/README.md)
            rather than here, so it never ends up in git.

    config ATCHOU_FALLBACK_SLEEP_SECONDS
        int "Sleep time when the server gave no next-wake time (s)"
        default 21600

    config ATCHOU_ALLOW_PLAIN_HTTP
        bool "Allow http:// server URLs (development only)"
        default n
        help
            The device token travels in a header, so keep this off for real use.

    config ATCHOU_PORTAL_TIMEOUT_SECONDS
        int "How long the setup portal stays open (s)"
        default 600
endmenu
```
